## firmware-source/sdkconfig.defaults.esp32c6
```kconfig
CONFIG_BOOTLOADER_APP_ROLLBACK_ENABLE=y
CONFIG_ESP_COEX_SW_COEXIST_ENABLE=y
CONFIG_MBEDTLS_PEM_WRITE_C=y
CONFIG_ESP_CONSOLE_UART_DEFAULT=y
```
